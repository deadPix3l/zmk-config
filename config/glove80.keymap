/* 
Glove80 Flash instructions

- hold bottom outside key (RF5, RF5) and Middle finger above home row (RT2, LT2)
- plug in (check that light pulses slowly, indicating bootloader mode)

- sudo mount /dev/XXX /mnt/usb
- cp *.uf2 /mnt/usb
- umount /mnt/usb
*/

#include <behaviors.dtsi>
/* Include all behaviour includes needed */
#include <dt-bindings/zmk/outputs.h>
#include <dt-bindings/zmk/keys.h>
#include <dt-bindings/zmk/bt.h>
#include <dt-bindings/zmk/rgb.h>

#include "../zmk-nodefree-config/helper.h"

/* source keypos definitions */
#include "../zmk-nodefree-config/keypos_def/keypos_glv80.h"

/* activate bluetooth */
#define CONFIG_WIRELESS 1

/* To deal with the situation where there is no Lower layer, to keep &lower happy */
#ifndef LAYER_Lower
#define LAYER_Lower 0
#endif

// Home row mods - whitelists for each hand
#define KEYS_L LC1 LC2 LC3 LC4 LC5 LN0 LN1 LN2 LN3 LN4 LN5 LT0 LT1 LT2 LT3 LT4 LT5 LM0 LM1 LM2 LM3 LM4 LM5 LB0 LB1 LB2 LB3 LB4 LB5 LF1 LF2 LF3 LF4 LF5
#define KEYS_R RC1 RC2 RC3 RC4 RC5 RN0 RN1 RN2 RN3 RN4 RN5 RT0 RT1 RT2 RT3 RT4 RT5 RM0 RM1 RM2 RM3 RM4 RM5 RB0 RB1 RB2 RB3 RB4 RB5 RF1 RF2 RF3 RF4 RF5
#define THUMBS LH0 LH1 LH2 LH3 LH4 LH5 RH0 RH1 RH2 RH3 RH4 RH5

/* left-hand HRMs */
ZMK_BEHAVIOR(hml, hold_tap,
    flavor = "balanced";
    tapping-term-ms = <400>;
    quick-tap-ms = <175>;                // repeat on tap-into-hold
    require-prior-idle-ms = <200>;
    bindings = <&kp>, <&kp>;
    hold-trigger-key-positions = <KEYS_R THUMBS>;
    hold-trigger-on-release;             // delay positional check until key-release
)

/* right-hand HRMs */
ZMK_BEHAVIOR(hmr, hold_tap,
    flavor = "balanced";
    tapping-term-ms = <400>;
    quick-tap-ms = <175>;                // repeat on tap-into-hold
    require-prior-idle-ms = <200>;
    bindings = <&kp>, <&kp>;
    hold-trigger-key-positions = <KEYS_L THUMBS>;
    hold-trigger-on-release;             // delay positional check until key-release
)

GLV80_LAYER(engram,
/* ╭─────────────┬─────────────┬─────────────┬─────────────┬─────────────╮                               ╭─────────────┬─────────────┬─────────────┬─────────────┬─────────────╮ */
      &kp F1        &kp F2        &kp F3        &kp F4        &kp F5                                        &kp F6        &kp F7        &kp F8        &kp F9        &kp F10
/* ├─────────────┼─────────────┼─────────────┼─────────────┼─────────────┼─────────────╮   ╭─────────────┼─────────────┼─────────────┼─────────────┼─────────────┼─────────────┤ */
      &kp EQUAL     &kp N1        &kp N2        &kp N3        &kp N4        &kp N5           &kp N6         &kp N7        &kp N8        &kp N9        &kp N0        &kp MINUS
/* ├─────────────┼─────────────┼─────────────┼─────────────┼─────────────┼─────────────┤   ├─────────────┼─────────────┼─────────────┼─────────────┼─────────────┼─────────────┤ */
      &kp TAB       &kp B         &kp Y         &kp O         &kp U         &kp SQT          &kp SEMI       &kp L         &kp D         &kp W         &kp V         &kp Z
/* ├─────────────┼─────────────┼─────────────┼─────────────┼─────────────┼─────────────┤   ├─────────────┼─────────────┼─────────────┼─────────────┼─────────────┼─────────────┤ */
      &kp ESC      &hml LGUI C   &hml LALT I  &hml LCTRL E   &hml LSHFT A   &kp COMMA        &kp DOT       &hmr RSHFT H  &hmr RCTRL T  &hmr RALT S   &hmr RGUI N    &kp Q
/* ├─────────────┼─────────────┼─────────────┼─────────────┼─────────────┼─────────────┤   ├─────────────┼─────────────┼─────────────┼─────────────┼─────────────┼─────────────┤ */
      &kp GRAVE     &kp G         &kp X         &kp J         &kp K         &kp MINUS    ,   &kp FSLH        &kp R        &kp M         &kp F         &kp P         &kp PG_UP
/* ├─────────────┼─────────────┼─────────────┼─────────────┼─────────────┼─────────────╯   ╰─────────────┼─────────────┼─────────────┼─────────────┼─────────────┼─────────────┤ */
      &magic        &kp HOME      &kp END       &kp LEFT      &kp RIGHT                  ,                   &kp UP       &kp DOWN      &kp LBKT      &kp RBKT      &kp PG_DN
/* ╰─────────────┴─────────────┴────────────┴─────────────┴─────────────╯                                ╰─────────────┴─────────────┴─────────────┴─────────────┴─────────────╯ */
                                                                                         ,
/*                                   ╭─────────────┬─────────────┬─────────────╮                   ╭─────────────┬─────────────┬─────────────╮                                         */
                                       &kp TAB         &kp EQUAL    &none                              &kp F24       &none        &kp ESC
/*                                   ├─────────────┼─────────────┼─────────────┤      */ , /*      ├─────────────┼─────────────┼─────────────┤                                         */
                                       &kp BSPC      &kp DEL       &key_repeat                        &kp RALT     &kp RET       &kp SPACE
/*                                   ╰─────────────┴─────────────┴─────────────╯                   ╰─────────────┴─────────────┴─────────────╯                                         */
)
